## arch/arm/mach-qemu/Kconfig
```kconfig
if ARCH_QEMU

config SYS_VENDOR
	default "emulation"

config SYS_BOARD
	default "qemu-arm"

config SYS_CONFIG_NAME
	default "qemu-arm"

config SYS_SDRAM_BASE
	hex "SDRAM base address"
	default 0x40000000
	help
	  The address that is start of SDRAM.

config SYS_FDT_ADDR
	hex "FDT load address"
	default 0x40000000
	help
	  The default FDT load address.

config SYS_RAMDISK_ADDR_R
	hex "Ramdisk load address"
	default 0x44200000
	help
	  The default initramfs load address.

config SYS_SCRIPT_ADDR
	hex "Script load address"
	default 0x44300000
	help
	  The default script load address.

config SYS_PXEFILE_ADDR_R
	hex "PXEfile load address"
	default 0x44400000
	help
	  The default PXEfile load address.

choice
	prompt "QEMU ARM architecture"
	default TARGET_QEMU_ARM_64BIT

config TARGET_QEMU_ARM_32BIT
	bool "ARMv7-A, 32bit"
	select ARCH_SUPPORT_PSCI
	select BOARD_LATE_INIT
	select CPU_V7A
	select SYS_ARCH_TIMER

config TARGET_QEMU_ARM_64BIT
	bool "ARMv8, 64bit"
	select ARM64
	select BOARD_LATE_INIT

config TARGET_QEMU_ARM_SBSA
	bool "SBSA Reference"
	select ARM64
	select BINMAN
	select BOARD_LATE_INIT
	select ENABLE_ARM_SOC_BOOT0_HOOK
	select MISC_INIT_R
endchoice

if TARGET_QEMU_ARM_32BIT || TARGET_QEMU_ARM_64BIT

config SYS_BOARD
	default "qemu-arm"

config SYS_CONFIG_NAME
	default "qemu-arm"

endif

if TARGET_QEMU_ARM_SBSA

config SYS_BOARD
	default "qemu-sbsa"

config SYS_CONFIG_NAME
	default "qemu-sbsa"

config SYS_SOC
	default "qemu-sbsa"

endif

endif
```

## lib/efi_driver/Kconfig
```kconfig
config EFI_GBL_AB_PROTOCOL
	bool "Include GBL AB boot protocol"
	depends on EFI_LOADER
	select CRC32
	help
	  Include the driver for the custom GBL AB boot slot protocol.
	  This protocol is used for determining the current boot slot,
	  marking boot attempts, changing the currently active slot,
	  and querying metadata about boot slots.

config EFI_GBL_FASTBOOT_PROTOCOL
	bool "Include GBL Fastboot customization protocol"
	depends on EFI_LOADER
	help
	  Include the driver for the custom GBL Fastboot customization protocol.
	  This protocol is used for defining custom fastboot variables,
	  custom oem commands, and driving a device-local bootloader session.

config EFI_GBL_FASTBOOT_TRANSPORT_PROTOCOL
	bool "Include GBL Fastboot Transport protocol implementation"
	depends on EFI_LOADER
	default y if EFI_GBL_FASTBOOT_TRANSPORT_PROTOCOL_SERIAL || EFI_GBL_FASTBOOT_TRANSPORT_PROTOCOL_DUMMY
	help
	  Include the driver for the GBL Fastboot Transport protocol.
          This protocol is used for defining fastboot transport.

config EFI_GBL_FASTBOOT_TRANSPORT_PROTOCOL_SERIAL
	bool "Include GBL Fastboot Transport protocol serial implementation"
	depends on EFI_LOADER
	help
	  Include the serial interactive driver for the GBL Fastboot Transport
          protocol. This protocol is used for defining fastboot transport.

config EFI_GBL_FASTBOOT_TRANSPORT_PROTOCOL_DUMMY
	bool "Include GBL Fastboot Transport protocol dummy implementation"
	depends on EFI_LOADER
	help
	  Include the dummy driver for the GBL Fastboot Transport protocol.
	  This protocol is used to verify multiple transport protocol
          registration and usage.

config EFI_GBL_OS_CONFIGURATION_PROTOCOL
	bool "Include GBL Os Configuration protocol"
	depends on EFI_LOADER
	help
	  Include the driver for the custom GBL os configuration protocol.
	  This protocol is used to select base device trees and overlays
	  and apply runtime fix-ups to kernel commandline and bootconfig.
```
